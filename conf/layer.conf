## conf/layer.conf
```bitbake
# We have a conf and classes directory, add to BBPATH
BBPATH .= ":${LAYERDIR}"

# We have recipes-* directories, add to BBFILES
BBFILES += "${LAYERDIR}/recipes-*/*/*.bb \
            ${LAYERDIR}/recipes-*/*/*.bbappend"

BBFILE_COLLECTIONS += "meta-mender-terberg"
BBFILE_PATTERN_meta-mender-terberg = "^${LAYERDIR}/"
BBFILE_PRIORITY_meta-mender-terberg = "6"
LAYERSERIES_COMPAT_meta-mender-terberg = "rocko"
```
